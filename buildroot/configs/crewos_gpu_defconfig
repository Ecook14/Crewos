## buildroot/configs/crewos_gpu_defconfig
```kconfig
BR2_x86_64=y
# System
BR2_TOOLCHAIN_BUILDROOT_MUSL=y
BR2_INIT_RUNE=y
BR2_ROOTFS_OVERLAY="overlay"
BR2_SYSTEM_DHCP="eth0"
BR2_GENERATE_LOCALE="en_US.UTF-8"
BR2_TARGET_GENERIC_HOSTNAME="crewos-gpu"
BR2_TARGET_GENERIC_ISSUE="Welcome to CrewOS GPU"

# Graphics Packages (Mesa, Vulkan)
BR2_PACKAGE_MESA3D=y
BR2_PACKAGE_MESA3D_GALLIUM_DRIVER_SWRAST=y
BR2_PACKAGE_MESA3D_GALLIUM_DRIVER_VIRGL=y
BR2_PACKAGE_MESA3D_VULKAN_DRIVER_INTEL=y
BR2_PACKAGE_MESA3D_VULKAN_DRIVER_AMD=y
BR2_PACKAGE_VULKAN_LOADER=y
BR2_PACKAGE_VULKAN_TOOLS=y
BR2_PACKAGE_SPIRV_TOOLS=y

# Base Packages
BR2_PACKAGE_BUSYBOX=y
BR2_PACKAGE_S6=y
BR2_PACKAGE_DROPBEAR=y
BR2_PACKAGE_CA_CERTIFICATES=y
BR2_PACKAGE_PCIUTILS=y

# Container Runtime (Lightweight Docker Alternative)
BR2_PACKAGE_CONTAINERD=y
BR2_PACKAGE_RUNC=y
BR2_PACKAGE_NERDCTL=y

# Version Control & Development
BR2_PACKAGE_GIT=y

# Networking for Containers
BR2_PACKAGE_CNI_PLUGINS=y

# Kernel
BR2_LINUX_KERNEL=n

# Filesystem
BR2_TARGET_ROOTFS_TAR=y
BR2_TARGET_ROOTFS_TAR_GZIP=y
BR2_TARGET_ROOTFS_EXT2=n
```

## buildroot/configs/crewos_lite_defconfig
```kconfig
BR2_x86_64=y
# System
BR2_TOOLCHAIN_BUILDROOT_MUSL=y
BR2_INIT_RUNE=y
BR2_ROOTFS_OVERLAY="overlay"
BR2_SYSTEM_DHCP="eth0"
BR2_GENERATE_LOCALE="en_US.UTF-8"
BR2_TARGET_GENERIC_HOSTNAME="crewos-lite"
BR2_TARGET_GENERIC_ISSUE="Welcome to CrewOS Lite"

# Packages
BR2_PACKAGE_BUSYBOX=y
BR2_PACKAGE_S6=y
BR2_PACKAGE_DROPBEAR=y
# Container Runtime (Lightweight Docker Alternative)
BR2_PACKAGE_CONTAINERD=y
BR2_PACKAGE_RUNC=y
BR2_PACKAGE_NERDCTL=y

# Version Control & Development
BR2_PACKAGE_GIT=y
# BR2_PACKAGE_GO is not set (Build on host or use custom overlay)

# Networking for Containers
BR2_PACKAGE_CNI_PLUGINS=y
BR2_PACKAGE_CA_CERTIFICATES=y

# Kernel (We build it separately, but Buildroot needs to know)
BR2_LINUX_KERNEL=n

# Filesystem
BR2_TARGET_ROOTFS_TAR=y
BR2_TARGET_ROOTFS_TAR_GZIP=y
BR2_TARGET_ROOTFS_EXT2=n
```
